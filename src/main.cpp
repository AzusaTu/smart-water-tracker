#include <Arduino.h>
#include <WiFi.h>
#include "Config.h"
#include "ScaleManager.h"
#include "DrinkTracker.h"
#include "Notifier.h"
#include "WebPortal.h"
#include "CloudSync.h"
#include "BleWaterService.h"

#if !defined(UNIT_TEST) && !defined(PIO_UNIT_TESTING)

// 核心物件實例
ScaleManager scale;
DrinkTracker tracker(scale);
Notifier notifier;
CloudSync cloudSync;
WebPortal portal(scale, tracker, notifier);
BleWaterService bleWaterService;

// 事件回呼處理
void onTrackerEvent(EventType type, int amountMl, int remainingMl) {
    if (type == EVENT_DRINK) {
        Serial.printf("[MAIN] 收到喝水事件: +%dml, 杯中剩餘: %dml, 今日總計: %dml\n",
                      amountMl, remainingMl, tracker.getTodayTotalMl());
        notifier.notifyDrink(amountMl, tracker.getTodayTotalMl(), tracker.getDailyGoalMl());
        cloudSync.queueEvent("drink", amountMl, remainingMl, tracker.getTodayTotalMl(), tracker.getDailyGoalMl());
        // BLE only receives accepted drink events. Refill handling remains unchanged.
        bleWaterService.recordDrink(time(nullptr), amountMl, remainingMl, tracker.getTodayTotalMl());
    } else if (type == EVENT_REFILL) {
        Serial.printf("[MAIN] 收到補水事件: +%dml, 杯中剩餘: %dml\n",
                      amountMl, remainingMl);
        notifier.notifyRefill(amountMl, remainingMl);
        cloudSync.queueEvent("refill", amountMl, remainingMl, tracker.getTodayTotalMl(), tracker.getDailyGoalMl());
    }
}

void onTrackerReminder() {
    Serial.printf("[MAIN] 收到久未喝水提醒 (已超過 %d 分鐘未喝水)\n",
                  tracker.getReminderIntervalMinutes());
    notifier.notifyReminder(tracker.getMinutesSinceLastDrink(),
                            tracker.getTodayTotalMl(),
                            tracker.getDailyGoalMl());
}

void setup() {
    Serial.begin(115200);
    delay(1000);
    Serial.println("\n==========================================");
    Serial.println("   智慧喝水偵測器 (ESP32-C3 SuperMini)     ");
    Serial.println("==========================================");

    // 1. 初始化通知與指示燈
    notifier.begin(PIN_STATUS_LED);

    // 2. 初始化稱重感測器
    if (!scale.begin(PIN_HX711_DT, PIN_HX711_SCK)) {
        Serial.println("[MAIN] ⚠️ HX711 感測器未就緒，請檢查接線！");
    }

    // 3. 綁定追蹤器回呼並啟動
    tracker.onDrinkEvent(onTrackerEvent);
    tracker.onReminder(onTrackerReminder);
    tracker.begin();

    // 4. 啟動雲端同步模組 (NTP 校時)
    cloudSync.begin();

    // Reuse the stable device ID already generated by CloudSync; BLE does not
    // depend on a configured cloud endpoint.
    bleWaterService.begin(cloudSync.getDeviceId());
    bleWaterService.updateSummary(tracker.getTodayTotalMl(), tracker.getDailyGoalMl());

    // 5. 啟動 Web 儀表板與網路
    portal.begin();

    Serial.println("[MAIN] 系統初始化完成，開始監控飲水狀態...");
}

void handleSerialCommands() {
    if (!Serial.available()) return;
    String cmd = Serial.readStringUntil('\n');
    cmd.trim();
    if (cmd.length() == 0) return;

    if (cmd.startsWith("WIFI:")) {
        // 格式: WIFI:SSID:PASSWORD
        int firstColon = cmd.indexOf(':');
        int secondColon = cmd.indexOf(':', firstColon + 1);
        if (secondColon > firstColon) {
            String ssid = cmd.substring(firstColon + 1, secondColon);
            String pass = cmd.substring(secondColon + 1);
            Preferences prefs;
            prefs.begin(PREFS_NAMESPACE, false);
            prefs.putString("wifi_ssid", ssid);
            prefs.putString("wifi_pass", pass);
            prefs.end();
            Serial.printf("[MAIN] 已儲存 WiFi 設定 (SSID: %s)，正在重啟連線...\n", ssid.c_str());
            delay(1000);
            ESP.restart();
        } else {
            Serial.println("[MAIN] 指令格式錯誤。正確格式: WIFI:您的SSID:您的密碼");
        }
    } else if (cmd.equalsIgnoreCase("TARE")) {
        scale.tare(15);
        Serial.println("[MAIN] 已執行去皮歸零");
    } else if (cmd.startsWith("CAL:")) {
        float weight = cmd.substring(4).toFloat();
        if (weight > 0) {
            if (scale.calibrateWithKnownWeight(weight)) {
                Serial.printf("[MAIN] 校準成功! 已知重量: %.1fg\n", weight);
            } else {
                Serial.println("[MAIN] 校準失敗");
            }
        }
    } else if (cmd.equalsIgnoreCase("SCAN")) {
        Serial.println("[MAIN] 正在掃描附近 2.4GHz WiFi 網路...");
        int n = WiFi.scanNetworks();
        Serial.printf("[MAIN] 掃描到 %d 個網路:\n", n);
        for (int i = 0; i < n; ++i) {
            Serial.printf("  [%d] SSID: '%s', RSSI: %d dBm, 加密: %s\n",
                          i + 1, WiFi.SSID(i).c_str(), WiFi.RSSI(i),
                          (WiFi.encryptionType(i) == WIFI_AUTH_OPEN) ? "開放" : "加密");
        }
    } else if (cmd.equalsIgnoreCase("RAW")) {
        Serial.printf("[MAIN] HX711 狀態: %s | 準備就緒: %s | 24-bit ADC 讀數: %ld | 濾波重: %.1fg\n",
                      scale.isConnected() ? "已連線" : "未連線/逾時",
                      scale.isReady() ? "就緒" : "等待中",
                      scale.getRawValue(),
                      scale.getFilteredWeight());
    } else if (cmd.equalsIgnoreCase("STATUS")) {
        Serial.printf("----------------------------------------\n");
        Serial.printf("[STATUS] 重量: %.1fg (原始: %.1f) | 狀態: %s | 今日總計: %dml\n",
                      scale.getFilteredWeight(), scale.getWeight(), tracker.getStateString(), tracker.getTodayTotalMl());
        if (WiFi.status() == WL_CONNECTED) {
            Serial.printf("[STATUS] WiFi 已連線: %s (IP: %s, 訊號: %d dBm)\n",
                          WiFi.SSID().c_str(), WiFi.localIP().toString().c_str(), WiFi.RSSI());
            Serial.printf("[STATUS] 網頁儀表板網址: http://%s 或 http://water.local\n",
                          WiFi.localIP().toString().c_str());
        } else {
            Serial.printf("[STATUS] WiFi 尚未連線 (狀態碼: %d), AP 熱點 IP: %s\n",
                          WiFi.status(), WiFi.softAPIP().toString().c_str());
            Serial.printf("[STATUS] 熱點名稱: %s (密碼: %s)\n",
                          AP_SSID_NAME, AP_DEFAULT_PASSWORD);
        }
        Serial.printf("----------------------------------------\n");
    } else if (cmd.equalsIgnoreCase("RESET")) {
        tracker.resetDailyTotal();
        Serial.println("[MAIN] 今日飲水量已重設");
    }
}

void loop() {
    // 處理 Serial 命令 (支援 USB 快速配網與校準)
    handleSerialCommands();

    // 週期性更新感測器讀數與濾波
    scale.update();

    // 週期性更新喝水狀態機
    tracker.update();

    // 處理 Web 請求與 Captive Portal
    portal.update();

    // 處理雲端同步佇列
    cloudSync.update();

    // Keep the GATT summary current without touching the drink-detection path.
    bleWaterService.updateSummary(tracker.getTodayTotalMl(), tracker.getDailyGoalMl());

    // 處理 LED 燈效與非阻塞動畫
    notifier.update();

    // 微小讓步給背景任務 (如 WiFi 協議棧)
    delay(10);
}

#endif  // !UNIT_TEST && !PIO_UNIT_TESTING
